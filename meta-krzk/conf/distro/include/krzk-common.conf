## meta-krzk/conf/distro/include/krzk-common.conf
```bitbake
# Some testing/development distro

require conf/distro/poky.conf

MAINTAINER = "krzk"

INIT_MANAGER = "systemd"
# systemd-networkd: not used, all interfaces are brought up by kernel based on cmdline
PACKAGECONFIG:remove:pn-systemd = "networkd"
```

## meta-krzk/conf/distro/krzk-musl.conf
```bitbake
# Some testing/development distro

require include/krzk-common.conf

DISTRO = "krzk"
DISTRO_NAME = "krzk development Linux"
DISTRO_VERSION = "1.0"

TCLIBC = "musl"
```

## meta-krzk/conf/distro/krzk.conf
```bitbake
# Some testing/development distro

require conf/distro/poky.conf

DISTRO = "krzk"
DISTRO_NAME = "krzk development Linux"
DISTRO_VERSION = "1.0"

MAINTAINER = "krzk"

DISTRO_FEATURES_append += " systemd"

PACKAGECONFIG_append_pn-civetweb = " caching cgi cpp debug ipv6 ssl websockets"
#PACKAGECONFIG_remove_pn-civetweb = " ssl server websockets"
```

## meta-krzk/conf/layer.conf
```bitbake
# Distro layer so add to beginning
BBPATH =. "${LAYERDIR}:"

# We have recipes-* directories, add to BBFILES
BBFILES += "${LAYERDIR}/recipes-*/*/*.bb \
            ${LAYERDIR}/recipes-*/*/*.bbappend"

BBFILE_COLLECTIONS += "krzk"
BBFILE_PATTERN_krzk = "^${LAYERDIR}/"
BBFILE_PRIORITY_krzk = "90"
LAYERVERSION_krzk = "2"
LAYERSERIES_COMPAT_krzk = "zeus warrior thud sumo rocko pyro"
```

## meta-krzk/conf/machine/odroid.conf
```bitbake
#@TYPE: Machine
#@NAME: Odroid ARMv7 machine

# Based on poky/meta/conf/machine/qemuarm.conf

# Odroid X: Cortex-A9
# Odroid HC1: Cortex-A15 + A7
require conf/machine/include/arm/armv7a/tune-cortexa9.inc

MACHINE_FEATURES = ""

MACHINEOVERRIDES =. "qemuall:qemuarm:"

# Don't include kernels in standard images
RDEPENDS:${KERNEL_PACKAGE_NAME}-base = ""
# Use a common kernel recipe for all machines
PREFERRED_PROVIDER_virtual/kernel = "linux-yocto"
KMACHINE:qemuarm = "qemuarma9"

KERNEL_IMAGETYPE = "zImage"
UBOOT_MACHINE ?= "qemu_arm_defconfig"
SERIAL_CONSOLES = "115200;ttySAC1 115200;ttySAC2"
```
